## main/Kconfig.projbuild
```kconfig
menu "LOT Project"

    rsource "../src/HW/Kconfig.in"
    rsource "../src/APP/Kconfig.in"
    rsource "../src/SYSTEM/Kconfig.in"

endmenu
```

## src/APP/Kconfig.in
```kconfig
menu "Application"

    rsource "ota/Kconfig.in"
    rsource "lot_lvgl/Kconfig.in"
    # rsource "network/Kconfig.in"

endmenu
```

## src/APP/lot_lvgl/Kconfig.in
```kconfig
menu "LVGL"

config LOT_LVGL_ENABLE
    bool "Enable LVGL UI"
    depends on LOT_LCD_ENABLE
    default y
    help
        Initialize LVGL and create demo UI after LCD init.

config LOT_LVGL_MAX_REFRESH_HZ
    int "UI max refresh rate (Hz)"
    depends on LOT_LVGL_ENABLE
    range 1 120
    default 33
    help
        Hardware-limited maximum refresh rate. Runtime API will reject values
        above this limit.

config LOT_LVGL_REFRESH_HZ
    int "UI refresh rate (Hz)"
    depends on LOT_LVGL_ENABLE
    range 1 LOT_LVGL_MAX_REFRESH_HZ
    default 10
    help
        Refresh rate for lot_ui_refresh() timer. Higher value gives smoother UI
        updates and higher CPU usage.

endmenu
```

## src/APP/modbus/Kconfig.in
```kconfig
menu "Modbus RTU Master"

config LOT_MODBUS_ENABLE
    bool "Enable Modbus RTU master"
    default n
    help
        Enables a FreeRTOS polling task that reads Modbus holding registers
        (FC03) over UART/RS485 and exposes them as sensor snapshots for
        proto uplink.

if LOT_MODBUS_ENABLE

config LOT_MODBUS_UART_PORT
    int "UART port number (0/1/2)"
    range 0 2
    default 1

config LOT_MODBUS_TX_PIN
    int "TX GPIO"
    range 0 48
    default 17

config LOT_MODBUS_RX_PIN
    int "RX GPIO"
    range 0 48
    default 18

config LOT_MODBUS_DE_PIN
    int "DE/RE GPIO for RS485 direction control (-1 = not used)"
    range -1 48
    default -1
    help
        Drive high before sending, low before receiving.
        Set to -1 if the transceiver uses auto-direction or is UART-only.

config LOT_MODBUS_BAUD
    int "Baud rate"
    default 9600

config LOT_MODBUS_POLL_MS
    int "Poll interval (ms)"
    range 100 60000
    default 1000

config LOT_MODBUS_CH_COUNT
    int "Number of channels to poll (1-2)"
    range 1 2
    default 2

comment "--- Channel 0 ---"

config LOT_MODBUS_CH0_SLAVE_ID
    int "Channel 0: slave ID"
    range 1 247
    default 1

config LOT_MODBUS_CH0_REG_ADDR
    hex "Channel 0: holding register address"
    default 0x0000

config LOT_MODBUS_CH0_SCALE_X100
    int "Channel 0: scale * 100  (10 = ×0.1 | 100 = ×1.0 | 1000 = ×10.0)"
    range 1 100000
    default 100

config LOT_MODBUS_CH0_ALARM_HI
    int "Channel 0: high-alarm threshold (raw register value, 0 = off)"
    range 0 65535
    default 0

config LOT_MODBUS_CH0_ALARM_LO
    int "Channel 0: low-alarm threshold (raw register value, 0 = off)"
    range 0 65535
    default 0

comment "--- Channel 1 ---"

config LOT_MODBUS_CH1_SLAVE_ID
    int "Channel 1: slave ID"
    depends on LOT_MODBUS_CH_COUNT >= 2
    range 1 247
    default 1

config LOT_MODBUS_CH1_REG_ADDR
    hex "Channel 1: holding register address"
    depends on LOT_MODBUS_CH_COUNT >= 2
    default 0x0001

config LOT_MODBUS_CH1_SCALE_X100
    int "Channel 1: scale * 100"
    depends on LOT_MODBUS_CH_COUNT >= 2
    range 1 100000
    default 100

config LOT_MODBUS_CH1_ALARM_HI
    int "Channel 1: high-alarm threshold (raw register value, 0 = off)"
    depends on LOT_MODBUS_CH_COUNT >= 2
    range 0 65535
    default 0

config LOT_MODBUS_CH1_ALARM_LO
    int "Channel 1: low-alarm threshold (raw register value, 0 = off)"
    depends on LOT_MODBUS_CH_COUNT >= 2
    range 0 65535
    default 0

endif # LOT_MODBUS_ENABLE

endmenu
```

## src/APP/network/Kconfig.in
```kconfig
menu "Network"

config LOT_NETWORK_ENABLE
    bool "Enable network protocol app"
    default y
    help
        Start application-layer network protocol client after Wi-Fi is up.

choice LOT_NETWORK_PROTOCOL
    prompt "Protocol"
    depends on LOT_NETWORK_ENABLE
    default LOT_NETWORK_PROTOCOL_MQTT

config LOT_NETWORK_PROTOCOL_MQTT
    bool "MQTT"

config LOT_NETWORK_PROTOCOL_WEBSOCKET
    bool "WebSocket"

endchoice

config LOT_NETWORK_LAUNCH_PRIORITY
    int "Launch priority (APP local)"
    depends on LOT_NETWORK_ENABLE
    range 0 99
    default 40

if LOT_NETWORK_PROTOCOL_MQTT

config LOT_MQTT_DEVICE_ID
    hex "Device ID (uint32, hex)"
    default 0x00000001
    help
        Unique device identifier embedded in every uplink frame.

config LOT_MQTT_PAYLOAD_PROTO
    bool "Use protobuf (nanopb) payload instead of JSON"
    default n
    help
        When enabled, status reports are encoded with Protocol Buffers
        (nanopb) instead of cJSON. Reduces payload size by ~60-70%.
        Requires the proto component and nanopb dependency.

config LOT_MQTT_BROKER_URI
    string "MQTT broker URI"
    default "mqtt://broker.emqx.io"

config LOT_MQTT_CLIENT_ID
    string "MQTT client id"
    default "lot_esp32s3"

config LOT_MQTT_SUB_TOPIC
    string "MQTT subscribe topic"
    default "lot/esp32s3/down"

config LOT_MQTT_PUB_TOPIC
    string "MQTT publish topic"
    default "lot/esp32s3/up"

config LOT_MQTT_REPORT_INTERVAL_SEC
    int "Status report interval (seconds)"
    default 30
    range 5 3600
    help
        How often the device publishes a status JSON to PUB_TOPIC.
        Fields: uptime, heap_free, heap_min, rssi, version.

endif

if LOT_NETWORK_PROTOCOL_WEBSOCKET

config LOT_WS_URI
    string "WebSocket server URI"
    default "ws://echo.websocket.events"

config LOT_WS_RECONNECT_TIMEOUT_MS
    int "WebSocket reconnect timeout (ms)"
    range 1000 60000
    default 5000

config LOT_WS_NETWORK_TIMEOUT_MS
    int "WebSocket network timeout (ms)"
    range 1000 60000
    default 10000

endif

endmenu
```

## src/APP/ota/Kconfig.in
```kconfig
menu "OTA"

config LOT_OTA_URL
    string "OTA image URL (http/https)"
    default ""
    help
        Firmware URL generated by idf.py build. Empty means OTA is skipped.

config LOT_OTA_VERSION_URL
    string "OTA version URL (http/https, text)"
    default ""
    help
        URL that returns latest firmware version text, e.g. "1.2.3".

config LOT_OTA_HTTP_TIMEOUT_MS
    int "OTA HTTP timeout (ms)"
    range 1000 120000
    default 10000
    help
        Timeout used by HTTP client during OTA.

config LOT_OTA_RESTART_ON_SUCCESS
    bool "Restart after OTA success"
    default y
    help
        Restart immediately after a successful OTA update.

endmenu
```

## src/HW/Kconfig.in
```kconfig
menu "Hardware"

    rsource "wifi/Kconfig.in"
    rsource "lcd/Kconfig.in"
    # rsource "ble/Kconfig.in"

endmenu
```

## src/HW/ble/Kconfig.in
```kconfig
menu "BLE"

config LOT_BLE_ENABLE
    bool "Enable BLE peripheral"
    default y

config LOT_BLE_DEVICE_NAME
    string "BLE device name"
    default "LOT-ESP32S3"
    depends on LOT_BLE_ENABLE

config LOT_BLE_LOCAL_PRIO
    int "BLE local launch priority in HW layer"
    range 0 99
    default 30
    depends on LOT_BLE_ENABLE

endmenu
```

## src/HW/lcd/Kconfig.in
```kconfig
menu "LCD (ILI9341 + XPT2046)"

config LOT_LCD_ENABLE
    bool "Enable SPI LCD"
    default y
    help
        Initialize ILI9341 LCD on boot.

config LOT_LCD_PIXEL_CLOCK_HZ
    int "LCD SPI clock (Hz)"
    depends on LOT_LCD_ENABLE
    range 1000000 40000000
    default 20000000
    help
        SPI pixel clock for ILI9341 panel IO.

config LOT_LCD_H_RES
    int "LCD horizontal resolution"
    depends on LOT_LCD_ENABLE
    range 1 1024
    default 240

config LOT_LCD_V_RES
    int "LCD vertical resolution"
    depends on LOT_LCD_ENABLE
    range 1 1024
    default 320

config LOT_LCD_SPI_SCLK_PIN
    int "LCD SPI SCLK GPIO"
    depends on LOT_LCD_ENABLE
    range -1 48
    default 18

config LOT_LCD_SPI_MOSI_PIN
    int "LCD SPI MOSI GPIO"
    depends on LOT_LCD_ENABLE
    range -1 48
    default 19

config LOT_LCD_SPI_MISO_PIN
    int "LCD SPI MISO GPIO"
    depends on LOT_LCD_ENABLE
    range -1 48
    default 21

config LOT_LCD_CS_PIN
    int "LCD CS GPIO"
    depends on LOT_LCD_ENABLE
    range -1 48
    default 4

config LOT_LCD_DC_PIN
    int "LCD DC GPIO"
    depends on LOT_LCD_ENABLE
    range -1 48
    default 5

config LOT_LCD_RST_PIN
    int "LCD RST GPIO"
    depends on LOT_LCD_ENABLE
    range -1 48
    default 3

config LOT_LCD_BK_LIGHT_PIN
    int "LCD Backlight GPIO (-1 to disable)"
    depends on LOT_LCD_ENABLE
    range -1 48
    default 2

config LOT_LCD_BK_LIGHT_ON_LEVEL
    int "LCD Backlight ON level"
    depends on LOT_LCD_ENABLE
    range 0 1
    default 1

config LOT_LCD_SWAP_XY
    bool "LCD swap XY"
    depends on LOT_LCD_ENABLE
    default n

config LOT_LCD_MIRROR_X
    bool "LCD mirror X"
    depends on LOT_LCD_ENABLE
    default y

config LOT_LCD_MIRROR_Y
    bool "LCD mirror Y"
    depends on LOT_LCD_ENABLE
    default n

config LOT_TOUCH_ENABLE
    bool "Enable XPT2046 touch"
    depends on LOT_LCD_ENABLE
    default y
    help
        Read touch coordinates from XPT2046 over SPI.

config LOT_TOUCH_CS_PIN
    int "Touch CS GPIO"
    depends on LOT_TOUCH_ENABLE
    range -1 48
    default 15

config LOT_TOUCH_USE_SEPARATE_SPI
    bool "Touch uses separate SPI bus"
    depends on LOT_TOUCH_ENABLE
    default n
    help
        Enable this when XPT2046 is not wired to the same SPI bus as LCD.

choice LOT_TOUCH_SPI_HOST
    prompt "Touch SPI host"
    depends on LOT_TOUCH_ENABLE && LOT_TOUCH_USE_SEPARATE_SPI
    default LOT_TOUCH_SPI_HOST_SPI3
    help
        Select SPI host used by the touch controller when using a separate bus.

config LOT_TOUCH_SPI_HOST_SPI2
    bool "SPI2_HOST"

config LOT_TOUCH_SPI_HOST_SPI3
    bool "SPI3_HOST"

endchoice

config LOT_TOUCH_SPI_SCLK_PIN
    int "Touch SPI SCLK GPIO"
    depends on LOT_TOUCH_ENABLE && LOT_TOUCH_USE_SEPARATE_SPI
    range -1 48
    default 12

config LOT_TOUCH_SPI_MOSI_PIN
    int "Touch SPI MOSI GPIO"
    depends on LOT_TOUCH_ENABLE && LOT_TOUCH_USE_SEPARATE_SPI
    range -1 48
    default 11

config LOT_TOUCH_SPI_MISO_PIN
    int "Touch SPI MISO GPIO"
    depends on LOT_TOUCH_ENABLE && LOT_TOUCH_USE_SEPARATE_SPI
    range -1 48
    default 13

config LOT_TOUCH_INT_PIN
    int "Touch INT GPIO (-1 to disable)"
    depends on LOT_TOUCH_ENABLE
    range -1 48
    default -1
    help
        XPT2046 PENIRQ pin. Set -1 to use polling mode.

config LOT_TOUCH_INT_ACTIVE_LEVEL
    int "Touch INT active level"
    depends on LOT_TOUCH_ENABLE
    range 0 1
    default 0
    help
        XPT2046 usually uses active-low PENIRQ, keep default 0.

config LOT_TOUCH_SWAP_XY
    bool "Touch swap XY"
    depends on LOT_TOUCH_ENABLE
    default n

config LOT_TOUCH_MIRROR_X
    bool "Touch mirror X"
    depends on LOT_TOUCH_ENABLE
    default n

config LOT_TOUCH_MIRROR_Y
    bool "Touch mirror Y"
    depends on LOT_TOUCH_ENABLE
    default n

config LOT_TOUCH_LOG_INTERVAL_MS
    int "Touch log interval (ms)"
    depends on LOT_TOUCH_ENABLE
    range 20 2000
    default 120
    help
        Minimum interval for printing touch coordinates.

endmenu
```

## src/HW/wifi/Kconfig.in
```kconfig
menu "Wi-Fi"

config LOT_WIFI_SSID
    string "Wi-Fi SSID"
    default "SSID"
    help
        Wi-Fi SSID for STA mode.

config LOT_WIFI_PASSWORD
    string "Wi-Fi Password"
    default "PASSWORD"
    help
        Wi-Fi password for STA mode.

config LOT_WIFI_BACKOFF_MAX_SEC
    int "Wi-Fi reconnect backoff max (sec)"
    range 10 300
    default 60
    help
        Maximum backoff interval for reconnect retries.
        Backoff doubles each attempt: 1s -> 2s -> 4s -> ... -> max.

config LOT_WIFI_CONNECT_TIMEOUT_MS
    int "Wi-Fi connect timeout (ms)"
    range 1000 120000
    default 20000
    help
        Timeout for waiting initial connection at boot.

config LOT_WIFI_POWERSAVE
    bool "Enable Wi-Fi power save mode"
    default n
    help
        Enable WIFI_PS_MIN_MODEM after station start.

config LOT_WIFI_FORCE_DNS
    bool "Force custom DNS after got IP"
    default n
    help
        Override DHCP DNS with CONFIG_LOT_WIFI_DNS_SERVER.

config LOT_WIFI_DNS_SERVER
    string "Custom DNS server"
    depends on LOT_WIFI_FORCE_DNS
    default "8.8.8.8"
    help
        IPv4 DNS server address, e.g. 8.8.8.8 or 1.1.1.1.

endmenu
```

## src/SYSTEM/Kconfig.in
```kconfig
menu "System"

    rsource "devinfo/Kconfig.in"
    rsource "version/Kconfig.in"
    rsource "sys_threadpool/Kconfig.in"
    rsource "power/Kconfig.in"
    rsource "ntp/Kconfig.in"
    rsource "lot_littlefs/Kconfig.in"

endmenu
```

## src/SYSTEM/devinfo/Kconfig.in
```kconfig
menu "Devinfo"

config LOT_DEVINFO_ENABLE
    bool "Enable device info module"
    default y

config LOT_DEVINFO_IDLE_LOAD
    bool "Enable CPU load estimation via idle hook"
    depends on LOT_DEVINFO_ENABLE
    default y

endmenu
```

## src/SYSTEM/launch/Kconfig.in
```kconfig
menu "Launch"

comment "Compile-time launch scan is enabled (no runtime launch table)."

endmenu
```

## src/SYSTEM/lot_littlefs/Kconfig.in
```kconfig
menu "LittleFS"

config LOT_LITTLEFS_ENABLE
    bool "Enable LittleFS mount"
    default y
    help
        Mount LittleFS partition at boot.

config LOT_LITTLEFS_BASE_PATH
    string "LittleFS base path"
    depends on LOT_LITTLEFS_ENABLE
    default "/lfs"
    help
        VFS mount path for LittleFS.

config LOT_LITTLEFS_PARTITION_LABEL
    string "LittleFS partition label"
    depends on LOT_LITTLEFS_ENABLE
    default "storage"
    help
        Partition label from partitions.csv.

config LOT_LITTLEFS_FORMAT_IF_FAIL
    bool "Format when mount failed"
    depends on LOT_LITTLEFS_ENABLE
    default y

endmenu
```

## src/SYSTEM/ntp/Kconfig.in
```kconfig
menu "NTP"

config LOT_NTP_ENABLE
    bool "Enable NTP sync"
    default y
    help
        Sync wall-clock time from NTP server during startup.

config LOT_NTP_SERVER
    string "NTP server"
    depends on LOT_NTP_ENABLE
    default "ntp.aliyun.com"
    help
        NTP hostname used for initial time synchronization.

config LOT_NTP_SYNC_TIMEOUT_SEC
    int "NTP sync timeout (sec)"
    depends on LOT_NTP_ENABLE
    range 3 120
    default 20
    help
        Timeout waiting for initial NTP time.

config LOT_NTP_SET_BJ_TZ
    bool "Use Beijing timezone (UTC+8)"
    depends on LOT_NTP_ENABLE
    default y
    help
        Set timezone to Asia/Shanghai after sync.

endmenu
```

## src/SYSTEM/power/Kconfig.in
```kconfig
menu "Power"

config LOT_POWER_ENABLE
    bool "Enable power module"
    default y

if LOT_POWER_ENABLE

config LOT_POWER_AUTO_START
    bool "Auto start power module in launch"
    default y

config LOT_POWER_LOG_BOOT_INFO
    bool "Log wakeup reason at boot"
    default y

config LOT_POWER_CONFIGURE_PM_ON_BOOT
    bool "Configure ESP PM on boot"
    default y

config LOT_POWER_MAX_CPU_FREQ_MHZ
    int "Max CPU frequency (MHz)"
    range 80 240
    default 240
    depends on LOT_POWER_CONFIGURE_PM_ON_BOOT

config LOT_POWER_MIN_CPU_FREQ_MHZ
    int "Min CPU frequency (MHz)"
    range 40 240
    default 80
    depends on LOT_POWER_CONFIGURE_PM_ON_BOOT

config LOT_POWER_AUTO_LIGHT_SLEEP
    bool "Allow automatic light sleep by PM"
    default n
    depends on LOT_POWER_CONFIGURE_PM_ON_BOOT

config LOT_POWER_DEFAULT_LIGHT_SLEEP_MS
    int "Default light sleep duration API argument (ms)"
    range 1 600000
    default 200

config LOT_POWER_MAX_LISTENERS
    int "Max number of power event listeners"
    range 1 16
    default 8

endif

endmenu
```
